// SPDX-License-Identifier: GPL-2.0-only
/*
 * Device Tree overlay for ILI9481 display on Raspberry Pi SPI0 CE0
 *
 * Default wiring:
 *   DC    = GPIO22
 *   RESET = GPIO27 (active low)
 *   SPI   = SPI0, CE0, 12 MHz (ILI9481 max per datasheet ≈ 15 MHz)
 *
 * Usage:
 *   dtc -@ -Hepapr -I dts -O dtb -o ili9481.dtbo ili9481-overlay.dts
 *   sudo cp ili9481.dtbo /boot/overlays/
 *   Add to /boot/config.txt: dtoverlay=ili9481
 *
 * Optional overrides:
 *   dtoverlay=ili9481,speed=12000000,rotate=90,dc=22,reset=27,panel=0
 *
 * panel values:
 *   0 = ILI9481 (default)
 *   1 = ILI9486
 *   2 = ILI9488
 */
/dts-v1/;
/plugin/;

/ {
	compatible = "brcm,bcm2835";

	/* Enable SPI0 */
	fragment@0 {
		target = <&spi0>;
		__overlay__ {
			status = "okay";
		};
	};

	/* Disable default spidev on CE0 */
	fragment@1 {
		target = <&spidev0>;
		__overlay__ {
			status = "disabled";
		};
	};

	/* ILI9481 display on SPI0 CE0 */
	fragment@2 {
		target = <&spi0>;
		__overlay__ {
			#address-cells = <1>;
			#size-cells = <0>;

			ili9481: ili9481@0 {
				compatible = "ilitek,ili9481";
				reg = <0>;		/* CE0 */
				spi-max-frequency = <12000000>;

				dc-gpios = <&gpio 22 0>;	/* GPIO22, active high */
				reset-gpios = <&gpio 27 1>;	/* GPIO27, active low */
				rotation = <0>;
				panel = <0>; /* 0=ILI9481, 1=ILI9486, 2=ILI9488 */
			};
		};
	};

	/*
	 * Optional: XPT2046 touch controller on SPI0 CE1
	 * Uncomment if your display has a resistive touch panel.
	 */
	/*
	fragment@3 {
		target = <&spi0>;
		__overlay__ {
			#address-cells = <1>;
			#size-cells = <0>;

			xpt2046: xpt2046@1 {
				compatible = "ti,ads7846";
				reg = <1>;
				spi-max-frequency = <2000000>;
				interrupts = <25 2>;
				interrupt-parent = <&gpio>;
				pendown-gpio = <&gpio 25 1>;

				ti,x-plate-ohms = /bits/ 16 <60>;
				ti,pressure-max = /bits/ 16 <255>;
			};
		};
	};
	*/

	/* Runtime overrides for /boot/config.txt */
	__overrides__ {
		speed   = <&ili9481>, "spi-max-frequency:0";
		rotate  = <&ili9481>, "rotation:0";
		dc      = <&ili9481>, "dc-gpios:4";
		reset   = <&ili9481>, "reset-gpios:4";
		panel   = <&ili9481>, "panel:0";
	};
};
